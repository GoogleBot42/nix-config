/* rk3399-kobol-helios64.dts */

/dts-v1/;
/ {
    model = "Kobol Helios64";
	compatible = "kobol,helios64\0rockchip,rk3399";
	fragment@0 {
		target-path = "/";
		__overlay__ {
			tsadc@ff260000 {
				status = "okay";
				rockchip,hw-tshut-mode = <0x01>;
				rockchip,hw-tshut-polarity = <0x01>;
			};
		};
	};
};
